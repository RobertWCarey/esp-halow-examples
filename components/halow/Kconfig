## components/halow/Kconfig
```kconfig
menu "Wi-Fi HaLow Connection Manager"

    config HALOW_COUNTRY_CODE
        string "Country code to use for Wi-Fi HaLow"
        default "??"

    config HALOW_SSID
        string "SSID for the Wi-Fi HaLow station"
        default "MorseMicro"

    config HALOW_PASSWORD
        string "Password for the Wi-Fi HaLow station"
        default "12345678"

    config ENABLE_DHCP
        bool "Enable DHCP"
        default y
        help
          If enabled, the station will use DHCP. If disabled,
          the static IP parameters in the submenu below become visible.

    menu "Static IP Configuration"
        depends on !ENABLE_DHCP

        config STATIC_LOCAL_IP
            string "Static Local IP"
            default "192.168.1.2"
            help
              The IP address to use when DHCP is not enabled.

        config STATIC_GATEWAY
            string "Static Gateway"
            default "192.168.1.1"
            help
              The gateway address to use when DHCP is not enabled.

        config STATIC_NETMASK
            string "Static Netmask"
            default "255.255.255.0"
            help
              The netmask to use when DHCP is not enabled.

    endmenu

    config ENABLE_AUTOCONFIG
        bool "Enable IPv6 Autoconfig"
        default n
        help
          If enabled, IPv6 addresses are automatically configured.
          If disabled, a static IPv6 address can be specified.

    config STATIC_LOCAL_IP6
        string "Static Local IPv6"
        default "FE80::2"
        depends on !ENABLE_AUTOCONFIG
        help
          The static IPv6 address to use when IPv6 autoconfiguration is disabled.

endmenu
```

## examples/battery_monitor/main/Kconfig.projbuild
```kconfig
menu "Example Configuration"

    config BROKER_URL
        string "Broker URL"
        default "mqtt://mqtt.eclipseprojects.io"
        help
            URL of the broker to connect to

    config BROKER_USERNAME
        string "Broker Username"
        default "admin"
        help
            Username for MQTT broker authentication

    config BROKER_PASSWORD
        string "Broker Password"
        default "admin"
        help
            Password for MQTT broker authentication

    config UPDATE_INTERVAL_MS
        int "Update interval (ms)"
        default 5000
        range 1000 3600000
        help
            Interval in milliseconds between sensor status updates.

    menu "Battery Configuration"
        config BATTERY_GPIO_PIN
            int "GPIO pin for battery voltage measurement"
            default 4
            range 0 39
            help
                GPIO pin connected to the battery voltage divider.
                Make sure this pin supports ADC functionality.

        config BATTERY_EMPTY_MV
            int "Empty battery voltage (mV)"
            default 3300
            range 2500 3500
            help
                Battery voltage in millivolts that corresponds to 0% battery level.

        config BATTERY_FULL_MV
            int "Full battery voltage (mV)"
            default 4000
            range 3600 4500
            help
                Battery voltage in millivolts that corresponds to 100% battery level.
    endmenu
endmenu
```

## examples/battery_monitor/sdkconfig.defaults
```kconfig
CONFIG_ESP32_DEFAULT_CPU_FREQ_240=y
CONFIG_ESP32S2_DEFAULT_CPU_FREQ_240=y
CONFIG_ESP32S3_DEFAULT_CPU_FREQ_240=y

CONFIG_ESPTOOLPY_FLASHFREQ_80M=y
CONFIG_ESPTOOLPY_FLASHMODE_QIO=y
CONFIG_ESPTOOLPY_FLASHSIZE_4MB=y

CONFIG_FREERTOS_HZ=1000

CONFIG_SPIRAM_SUPPORT=y
CONFIG_ESP32_SPIRAM_SUPPORT=y
CONFIG_ESP32S2_SPIRAM_SUPPORT=y
CONFIG_ESP32S3_SPIRAM_SUPPORT=y
CONFIG_SPIRAM_MODE_OCT=y
CONFIG_SPIRAM_SPEED_80M=y
CONFIG_SPIRAM_MEMTEST=n

CONFIG_SPIRAM_MALLOC_ALWAYSINTERNAL=1580
CONFIG_FREERTOS_IDLE_TASK_STACKSIZE=1536

CONFIG_BOOTLOADER_SKIP_VALIDATE_IN_DEEP_SLEEP=y
CONFIG_BOOTLOADER_SKIP_VALIDATE_ON_POWER_ON=y
CONFIG_BOOTLOADER_SKIP_VALIDATE_ALWAYS=y

CONFIG_HTTPD_MAX_REQ_HDR_LEN=1214

CONFIG_LWIP_NETIF_STATUS_CALLBACK=y

CONFIG_IDF_TARGET="esp32s3"

CONFIG_LWIP_IRAM_OPTIMIZATION=y
CONFIG_LWIP_TCP_MSS=1460
CONFIG_LWIP_TCP_SND_BUF_DEFAULT=8760
CONFIG_LWIP_TCP_WND_DEFAULT=14600
CONFIG_LWIP_TCP_RECVMBOX_SIZE=10
CONFIG_LWIP_UDP_RECVMBOX_SIZE=10

CONFIG_PARTITION_TABLE_SINGLE_APP_LARGE=y

CONFIG_MBEDTLS_NIST_KW_C=y

CONFIG_ESP32S3_INSTRUCTION_CACHE_32KB=y

# Changes specific to 3-0062 board
CONFIG_MM_RESET_N=1
CONFIG_MM_WAKE=2
CONFIG_MM_BUSY=3
CONFIG_MM_SPI_SCK=7
CONFIG_MM_SPI_MOSI=9
CONFIG_MM_SPI_MISO=8
CONFIG_MM_SPI_CS=44
CONFIG_MM_SPI_IRQ=43
CONFIG_MM_BCF_FILE="bcf_mf08651_us.mbin"
CONFIG_MM_FW_FILE="mm6108.mbin"
```

## examples/camera/mqtt_pic_client/main/Kconfig.projbuild
```kconfig
menu "Example Configuration"

    config BROKER_URL
        string "Broker URL"
        default "mqtt://mqtt.eclipseprojects.io"
        help
            URL of the broker to connect to

    config BROKER_USERNAME
        string "Broker Username"
        default "admin"
        help
            Username for MQTT broker authentication

    config BROKER_PASSWORD
        string "Broker Password"
        default "admin"
        help
            Password for MQTT broker authentication

    config CAMERA_IMAGE_TOPIC
        string "Topic to publish image"
        default "camera/image"
        help
            Topic to publish the image captured by the camera.

    choice IMAGE_FORMAT
            prompt "image format"
            default IMAGE_JPEG_FORMAT
            help
                Different image formats mean different amounts of data and image quality.
            config IMAGE_JPEG_FORMAT
                bool "JPEG"
                help
                    The image data in JPEG format is compressed data, so it is more suitable for network transmission.
                    In particular, use this format when a camera that can output jpeg format is used.
            config IMAGE_BMP_FORMAT
                bool "BMP"
                help
                    The image data in BMP format is uncompressed data.
                    Data in this format will take up a lot of memory, but it can bring lossless image quality.
    endchoice
endmenu
```

## examples/temperature_sensor/main/Kconfig.projbuild
```kconfig
menu "Example Configuration"

    config BROKER_URL
        string "Broker URL"
        default "mqtt://mqtt.eclipseprojects.io"
        help
            URL of the broker to connect to

    config BROKER_USERNAME
        string "Broker Username"
        default "admin"
        help
            Username for MQTT broker authentication

    config BROKER_PASSWORD
        string "Broker Password"
        default "admin"
        help
            Password for MQTT broker authentication

    config UPDATE_INTERVAL_MS
        int "Update interval (ms)"
        default 5000
        range 1000 3600000
        help
            Interval in milliseconds between sensor status updates.

    menu "Sensor Configuration"
        config I2C_MASTER_SCL_IO
            int "SCL GPIO for the I2C master"
            default 6
            range 0 39
            help
                GPIO number for the SCL pin of the I2C master.

        config I2C_MASTER_SDA_IO
            int "SDA GPIO for the I2C master"
            default 5
            range 0 39
            help
                GPIO number for the SDA pin of the I2C master.
    endmenu
endmenu
```

## examples/temperature_sensor/sdkconfig.defaults
```kconfig
## MMIOT Specific changes ##

CONFIG_FREERTOS_HZ=1000

# Currently libmorse.a has only been compiled for ESP32S3
CONFIG_IDF_TARGET="esp32s3"

CONFIG_MBEDTLS_NIST_KW_C=y

CONFIG_LWIP_NETIF_STATUS_CALLBACK=y
CONFIG_LWIP_IPV6_AUTOCONFIG=y
CONFIG_LWIP_IPV6_DHCP6=y

CONFIG_PARTITION_TABLE_SINGLE_APP_LARGE=y

## Changes specific to 3-0062 board ##
CONFIG_MM_RESET_N=1
CONFIG_MM_WAKE=2
CONFIG_MM_BUSY=3
CONFIG_MM_SPI_SCK=7
CONFIG_MM_SPI_MOSI=9
CONFIG_MM_SPI_MISO=8
CONFIG_MM_SPI_CS=44
CONFIG_MM_SPI_IRQ=43
CONFIG_MM_BCF_FILE="bcf_mf08651_us.mbin"
CONFIG_MM_FW_FILE="mm6108.mbin"
```
